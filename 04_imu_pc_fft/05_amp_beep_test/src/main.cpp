/*
 * NS4168 amplifier square-wave test
 *
 * Purpose: send square-wave PCM data generated by the ESP32-S3 directly to the NS4168 amplifier,
 * without relying on the microphone, PSRAM, or recorded audio; verify the I2S1 -> NS4168 -> speaker path.
 *
 * Principle: a square wave consists of summed sinusoidal harmonics, including strong odd harmonics;
 * the NS4168 class-D amplifier can amplify it to produce an audible beep.
 *
 * Serial commands (115200 baud, native USB CDC):
 * P           Play a 440 Hz square wave for 3 seconds (concert A4)
 * L           Play continuously (until any key is pressed); useful for checking speaker vibration/current
 * S           Stop
 * 1 / 2 / 3   Change frequency (1=261 Hz C4 / 2=440 Hz A4 / 3=880 Hz A5)
 * V <0-100>   Volume percentage (default 50)
 * H           Help
 *
 * Pins: BCLK=GPIO41, LRC=GPIO42, DIN=GPIO2 (finalized project pinout)
 * See README.md for wiring, power, and MUTE connections
 */

#include <Arduino.h>
#include <driver/i2s.h>

// ============ Pins ============
#define AMP_BCLK  41
#define AMP_LRC   42
#define AMP_DIN   2

#define AMP_I2S_PORT    I2S_NUM_1
#define AMP_SAMPLE_RATE 16000

// ============ State ============
static float current_freq = 440.0f;    // Default: A4
static int  current_volume = 50;        // 0-100
static bool continuous = false;         // Continuous playback mode

// Square-wave buffer (samples per period = SAMPLE_RATE / freq)
// 440 Hz at 16 kHz: ~36 samples/period; 880 Hz: ~18; 261 Hz: ~61
// Precompute 0.5 seconds of samples and replay in a loop
#define BUFFER_SECONDS  0.5f
#define BUFFER_SAMPLES  ((int)(AMP_SAMPLE_RATE * BUFFER_SECONDS))
static int16_t wave_buffer[BUFFER_SAMPLES];

// ============ I2S initialization ============
static bool amp_init() {
  i2s_config_t config = {
    .mode = (i2s_mode_t)(I2S_MODE_MASTER | I2S_MODE_TX),
    .sample_rate = AMP_SAMPLE_RATE,
    .bits_per_sample = I2S_BITS_PER_SAMPLE_16BIT,
    .channel_format = I2S_CHANNEL_FMT_ONLY_LEFT,
    .communication_format = I2S_COMM_FORMAT_STAND_I2S,
    .intr_alloc_flags = ESP_INTR_FLAG_LEVEL1,
    .dma_buf_count = 8,
    .dma_buf_len = 256,
    .use_apll = false,
    .tx_desc_auto_clear = true,
    .fixed_mclk = 0,
  };
  i2s_pin_config_t pins = {
    .bck_io_num = AMP_BCLK,
    .ws_io_num = AMP_LRC,
    .data_out_num = AMP_DIN,
    .data_in_num = I2S_PIN_NO_CHANGE,
  };
  if (i2s_driver_install(AMP_I2S_PORT, &config, 0, NULL) != ESP_OK) return false;
  if (i2s_set_pin(AMP_I2S_PORT, &pins) != ESP_OK) return false;
  return true;
}

// ============ Square-wave generation ============
static void generate_square_wave(float freq, int volume) {
  // Map volume 0-100 to amplitude 0-32000 (int16 maximum: 32767)
  int32_t amp = (int32_t)volume * 320;
  if (amp > 32000) amp = 32000;

  float period_samples = AMP_SAMPLE_RATE / freq;
  for (int i = 0; i < BUFFER_SAMPLES; i++) {
    // Square wave: +amp during first half of each period, -amp during second half
    float phase = fmodf(i, period_samples) / period_samples;
    wave_buffer[i] = (phase < 0.5f) ? amp : -amp;
  }
  Serial.print("[GEN] square wave: freq=");
  Serial.print(freq, 0);
  Serial.print("Hz vol=");
  Serial.print(volume);
  Serial.print("% amp=");
  Serial.println(amp);
}

// ============ Play for N seconds ============
static void play_seconds(float seconds) {
  Serial.print("[PLAY] ");
  Serial.print(seconds, 1);
  Serial.print("s @ ");
  Serial.print(current_freq, 0);
  Serial.println("Hz ...");

  int total_samples = (int)(seconds * AMP_SAMPLE_RATE);
  int played = 0;
  while (played < total_samples) {
    int chunk = BUFFER_SAMPLES;
    if (played + chunk > total_samples) chunk = total_samples - played;
    size_t bytes_written = 0;
    i2s_write(AMP_I2S_PORT, wave_buffer, chunk * sizeof(int16_t),
              &bytes_written, portMAX_DELAY);
    played += bytes_written / sizeof(int16_t);
  }
  i2s_zero_dma_buffer(AMP_I2S_PORT);
  Serial.println("[PLAY] done");
}

// ============ Help ============
static void show_help() {
  Serial.println();
  Serial.println("=====================================");
  Serial.println("  NS4168 Amp Beep Test (square wave)");
  Serial.println("  ESP32-S3 | I2S1");
  Serial.print  ("  BCLK=GPIO41 LRC=GPIO42 DIN=GPIO2");
  Serial.println("=====================================");
  Serial.println("Commands:");
  Serial.println("  P           Play 3s beep");
  Serial.println("  L           Loop play (any key stops)");
  Serial.println("  S           Stop");
  Serial.println("  1/2/3       Freq: 261 / 440 / 880 Hz");
  Serial.println("  V <0-100>   Volume");
  Serial.println("  H           This help");
  Serial.print  ("Current: freq=");
  Serial.print(current_freq, 0);
  Serial.print("Hz vol=");
  Serial.print(current_volume);
  Serial.println("%");
  Serial.println();
}

// ============ Command handling ============
static String input_buf;

static void process_cmd(const String& cmd) {
  String s = cmd; s.trim(); s.toUpperCase();
  if (s.length() == 0) return;

  // Stop continuous mode on any command
  continuous = false;

  if (s == "P") { play_seconds(3.0f); return; }
  if (s == "S") { Serial.println("[INFO] stopped"); return; }
  if (s == "H") { show_help(); return; }

  if (s == "1") { current_freq = 261.0f; generate_square_wave(current_freq, current_volume); Serial.println("[INFO] freq=261Hz (C4)"); return; }
  if (s == "2") { current_freq = 440.0f; generate_square_wave(current_freq, current_volume); Serial.println("[INFO] freq=440Hz (A4)"); return; }
  if (s == "3") { current_freq = 880.0f; generate_square_wave(current_freq, current_volume); Serial.println("[INFO] freq=880Hz (A5)"); return; }

  if (s == "L") {
    continuous = true;
    Serial.println("[INFO] continuous play started, press any key to stop");
    return;
  }

  if (s.startsWith("V")) {
    int sp = s.indexOf(' ');
    if (sp < 0) { Serial.println("[INFO] usage: V <0-100>"); return; }
    int v = s.substring(sp + 1).toInt();
    if (v < 0) v = 0;
    if (v > 100) v = 100;
    current_volume = v;
    generate_square_wave(current_freq, current_volume);
    Serial.print("[INFO] volume = ");
    Serial.print(v);
    Serial.println("%");
    return;
  }

  Serial.print("[ERR] Unknown: ");
  Serial.println(s);
}

// ============ Entry point ============
void setup() {
  Serial.begin(115200);
  delay(500);

  Serial.println();
  Serial.println("############################################");
  Serial.println("#   NS4168 Amp Beep Test");
  Serial.println("#   ESP32-S3 | I2S1 | square wave");
  Serial.println("############################################");

  if (!amp_init()) {
    Serial.println("[ERR] I2S1 init failed! Check pin assignment.");
    while (true) { delay(1000); }
  }
  Serial.println("[INFO] I2S1 init OK");

  // Precompute 440 Hz square wave at 50% volume
  generate_square_wave(current_freq, current_volume);

  show_help();
  Serial.println("[INFO] Ready. Press 'P' to play a 3-second beep.");
}

void loop() {
  // Continuous playback mode
  if (continuous) {
    size_t bytes_written = 0;
    i2s_write(AMP_I2S_PORT, wave_buffer, BUFFER_SAMPLES * sizeof(int16_t),
              &bytes_written, portMAX_DELAY);
    // Exit continuous mode if serial input is available
    if (Serial.available()) {
      continuous = false;
      i2s_zero_dma_buffer(AMP_I2S_PORT);
      Serial.println("[INFO] continuous play stopped");
    }
    return;
  }

  // Command handling
  while (Serial.available()) {
    char c = Serial.read();
    if (c == '\n' || c == '\r') {
      if (input_buf.length() > 0) {
        Serial.print("> ");
        Serial.println(input_buf);
        process_cmd(input_buf);
        input_buf = "";
      }
    } else {
      input_buf += c;
    }
  }
  delay(1);
}
